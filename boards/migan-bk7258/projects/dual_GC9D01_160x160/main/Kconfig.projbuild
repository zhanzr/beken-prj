## boards/migan-bk7258/projects/dual_GC9D01_160x160/main/Kconfig.projbuild
```kconfig
menu "dual_GC9D01_160x160 panel config"

config LCD_SPI_GC9D01
	bool "Enable LCD_SPI_GC9D01 panel (160x160, dual lcd mode)"
	default y

endmenu
```

## boards/migan-bk7258/projects/dual_lcd_test/main/Kconfig.projbuild
```kconfig
menu "dual_lcd_test panel config"

config LCD_SPI_GC9D01
	bool "Enable LCD_SPI_GC9D01 panel (160x160, dual lcd mode)"
	default y

endmenu
```
